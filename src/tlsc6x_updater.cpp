
#include <M5Unified.h>
#include <esp_log.h>

static constexpr char LOG_TAG[] = "tlsc6x";
static constexpr int i2c_freq = 400000;
static constexpr uint8_t g_tlsc6x_client = 0x2E;

extern const uint8_t fw_burn_bin[2672];
extern const uint8_t fw_fcode_burn[1776];
#include "tlsc6x_boot.h"

#define EPERM 1

struct tlsc6x_updfile_header {
  uint32_t sig;
  uint32_t resv;
  uint32_t n_cfg;
  uint32_t n_match;
  uint32_t len_cfg;
  uint32_t len_boot;
};

#define MAX_CHIP_ID   (10)
extern uint8_t tlsc6x_chip_name[MAX_CHIP_ID][20];
unsigned int g_tlsc6x_cfg_ver = 0; 
unsigned int g_tlsc6x_boot_ver = 0;
unsigned int g_needKeepRamCode = 0;//// diff 3535  3536
uint16_t g_tlsc6x_chip_code = 0;  //g_tlsc6x_chip_code嚥厘望IC侏催斤哘購狼:
                                                                  //{"null", "tlsc6206a", "tlsc6306", "tlsc6206", "tlsc6324", "tlsc6332", "tlsc6440","tlsc6448","tlsc6432","tlsc6424","tlsc6406bf","tlsc6413","tlsc6417","tlsc6540"};   

int tlsc_boot_version=-1;
int tlsc_cfg_version=-1;
int tlsc_vendor_id=-1;
int tlsc_project_id=-1;


unsigned int g_mccode = 0;  /* 0:3535, 1:3536 */

extern struct mutex i2c_rw_access;

static uint32_t fw_size;


//#ifdef TLSC_AUTO_UPGRADE
static int new_idx_active = -1;  // diff 3535  3536
//#endif

/* Telink CTP */
unsigned int MTK_TXRX_BUF;
unsigned int CMD_ADDR;
unsigned int RSP_ADDR;

typedef struct __test_cmd_wr {
  /* offset 0; */
  uint8_t id;  /* cmd_id; */
  uint8_t idv;  /* inverse of cmd_id */
  uint16_t d0;  /* data 0 */
  uint16_t d1;  /* data 1 */
  uint16_t d2;  /* data 2 */
  /* offset 8; */
  uint8_t resv;  /* offset 8 */
  uint8_t tag;  /* offset 9 */
  uint16_t chk;  /* 16 bit checksum */
  uint16_t s2Pad0;  /*  */
  uint16_t s2Pad1;  /*  */
} ctp_test_wr_t;

typedef struct __test_cmd_rd {
  /* offset 0; */
  uint8_t id;  /* cmd_id; */
  uint8_t cc;  /* complete code */
  uint16_t d0;  /* data 0 */
  uint16_t sn;  /* session number */
  uint16_t chk;  /* 16 bit checksum */
} ctp_test_rd_t;
#define DIRECTLY_MODE   (0x0)
#define DEDICATE_MODE   (0x1)
#define MAX_TRX_LEN (64)  /* max IIC data length */
/* #define CMD_ADDR    (0xb400) */
/* #define RSP_ADDR    (0xb440) */
/* #define MTK_TXRX_BUF    (0xcc00)  // 1k, buffer used for memory r &w */

#define LEN_CMD_CHK_TX  (10)
#define LEN_CMD_PKG_TX  (16)

#define LEN_RSP_CHK_RX  (8)
#define MAX_BULK_SIZE    (1024)
uint16_t tl_target_cfg[102];
uint16_t tl_buf_tmpcfg[102];
/* to direct memory access mode */
uint8_t cmd_2dma_42bd[6] = { /*0x42, 0xbd, */ 0x28, 0x35, 0xc1, 0x00, 0x35, 0xae };

int tlsc6x_read_bytes_u16addr_sub(uint8_t addr, uint16_t reg, uint8_t *data, size_t len)
{
  return
    !( M5.In_I2C.start(addr, false, i2c_freq)
    && M5.In_I2C.write(reg>>8)
    && M5.In_I2C.write(reg)
    && M5.In_I2C.restart(addr, true, i2c_freq)
    && M5.In_I2C.read(data, len)
    && M5.In_I2C.stop()
    );
}

int tlsc6x_read_bytes_u16addr(uint8_t addr, uint16_t reg, uint8_t *data, size_t len)
{
  return tlsc6x_read_bytes_u16addr_sub(addr, reg, data, len);
}

int tlsc6x_write_bytes_u16addr_sub(uint8_t addr, uint16_t reg, const uint8_t* data, size_t len)
{
  return
    !( M5.In_I2C.start(addr, false, i2c_freq)
    && M5.In_I2C.write(reg>>8)
    && M5.In_I2C.write(reg)
    && M5.In_I2C.write(data, len)
    && M5.In_I2C.stop()
    );
}

int tlsc6x_write_bytes_u16addr(uint8_t addr, uint16_t reg, const uint8_t* data, size_t len)
{
  return tlsc6x_write_bytes_u16addr_sub(addr, reg, data, len);
}

/* <0 : i2c error */
/* 0: direct address mode */
/* 1: protect mode */
int tlsc6x_get_i2cmode(void)
{
  uint8_t regData[4];

  if (tlsc6x_read_bytes_u16addr_sub(g_tlsc6x_client, 0x01, regData, 3)) {
    return -EPERM;
  }

  if (((uint8_t) (g_tlsc6x_client) == (regData[0] >> 1)) && (regData[2] == 0X01)) {
    return DIRECTLY_MODE;
  }
  return DEDICATE_MODE;
}

/* 0:successful */
int tlsc6x_set_dd_mode_sub(void)
{
  int mod = -1;
  int retry = 0;
  int ret = 0;
  ret = tlsc6x_get_i2cmode();
  if (ret < 0) {
    return ret;
  }
  if (ret == DIRECTLY_MODE) {
    return 0;
  }

  while (retry++ < 5) {
    delay(20);
    tlsc6x_write_bytes_u16addr_sub(g_tlsc6x_client, 0x42bd, cmd_2dma_42bd, 6);
    delay(30);
    mod = tlsc6x_get_i2cmode();
    if (mod == DIRECTLY_MODE) {
      break;
    }
  }

  if (mod == DIRECTLY_MODE) {
    return 0;
  } else {
    return -EPERM;
  }
}

int tlsc6x_set_dd_mode(void)
{
  return tlsc6x_set_dd_mode_sub();
}

/* 0:successful */
int tlsc6x_set_nor_mode_sub(void)
{
  int mod = -1;
  int retry = 0;
  uint8_t reg = 0x05;

  while (retry++ < 5) {
    tlsc6x_write_bytes_u16addr_sub(g_tlsc6x_client, 0x03, &reg, 1);
    delay(5);
    mod = tlsc6x_get_i2cmode();
    if (mod == DEDICATE_MODE) {
      break;
    }
    delay(50);
  }
  if (mod == DEDICATE_MODE) {
    return 0;
  } else {
    return -EPERM;
  }
}

int tlsc6x_set_nor_mode(void)
{
  return  tlsc6x_set_nor_mode_sub();
}

/* ret=0 : successful */
/* write with read-back check, in dd mode */
static int tlsc6x_bulk_down_check(const uint8_t *pbuf, uint16_t addr, uint16_t len)
{
  unsigned int j, k, retry;
  uint8_t rback[128];

  while (len) {
    k = (len < 128) ? len : 128;
    retry = 0;
    do {
      rback[k - 1] = pbuf[k - 1] + 1;
      tlsc6x_write_bytes_u16addr(g_tlsc6x_client, addr, pbuf, k);
      tlsc6x_read_bytes_u16addr(g_tlsc6x_client, addr, rback, k);
      for (j = 0; j < k; j++) {
        if (pbuf[j] != rback[j]) {
          break;
        }
      }
      if (j >= k) {
        break;  /* match */
      }
    } while (++retry < 3);

    if (j < k) {
      break;
    }

    addr += k;
    pbuf += k;
    len -= k;
  }

  return (int)len;
}

static uint16_t tlsc6x_checksum_u16(const uint16_t *buf, uint16_t length)
{
  uint16_t sum, len, i;

  sum = 0;

  len = length >> 1;

  for (i = 0; i < len; i++) {
    sum += buf[i];
  }

  return sum;
}

static uint32_t tlsc6x_checksumEx(const uint8_t *buf, uint16_t length)
{
  uint32_t combChk;
  uint16_t k, check, checkEx;

  check = 0;
  checkEx = 0;
  for (k = 0; k < length; k++) {
    check += buf[k];
    checkEx += (uint16_t) (k * buf[k]);
  }
  combChk = (checkEx << 16) | check;

  return combChk;

}

/* 0:successful */
int tlsc6x_download_ramcode(const uint8_t *pcode, uint16_t len)
{
  uint8_t dwr, retry;
  int ret = -2;
  int sig;

  if (tlsc6x_set_dd_mode()) {
    return -EPERM;
  }

  sig = (int) pcode[3];
  sig = (sig<<8) + (int) pcode[2];
  sig = (sig<<8) + (int) pcode[1];
  sig = (sig<<8) + (int) pcode[0];

  if (sig == 0x6d6f8008) {
    sig = 0;
    tlsc6x_read_bytes_u16addr(g_tlsc6x_client, 0x8000, (uint8_t *) &sig, 4);
    if (sig == 0x6d6f8008) {
      return 0;
    }
  }

  dwr = 0x05;
  if (tlsc6x_bulk_down_check(&dwr, 0x0602, 1) == 0) {  /* stop mcu */
    dwr = 0x00;
    tlsc6x_bulk_down_check(&dwr, 0x0643, 1);  /* disable irq */
  } else {
    return -EPERM;
  }
  if (tlsc6x_bulk_down_check(pcode, 0x8000, len) == 0) {
    dwr = 0x88;
    retry = 0;
    do {
      ret = tlsc6x_write_bytes_u16addr(g_tlsc6x_client, 0x0602, &dwr, 1);
    } while ((++retry < 3) && (ret != 0));
  }
  
  delay(30);   // let caller decide the delay time ?

  return ret;
}

/* return 0=successful: send cmd and get rsp. */
static int tlsc6x_cmd_send(ctp_test_wr_t *ptchcw, ctp_test_rd_t *pcr)
{
  int ret;
  uint32_t retry;

  retry = 0;
  tlsc6x_write_bytes_u16addr(g_tlsc6x_client, RSP_ADDR, (const uint8_t *) &retry, 1);

  /* send command */
  ptchcw->idv = ~(ptchcw->id);
  ptchcw->tag = 0x35;
  ptchcw->chk = 1 + ~(tlsc6x_checksum_u16((uint16_t *) ptchcw, LEN_CMD_CHK_TX));
  ptchcw->tag = 0x30;
  ret = tlsc6x_write_bytes_u16addr(g_tlsc6x_client, CMD_ADDR, (const uint8_t *) ptchcw, LEN_CMD_PKG_TX);
  if (ret) {
    goto exit;
  }
  ptchcw->tag = 0x35;
  ret = tlsc6x_write_bytes_u16addr(g_tlsc6x_client, CMD_ADDR + 9, (const uint8_t *) &(ptchcw->tag), 1);
  if (ret) {
    goto exit;
  }
  /* polling rsp, the caller must init rsp buffer. */
  ret = -1;
  retry = 0;
  while (retry++ < 100) {  /* 2s */
    delay(20);
    if (tlsc6x_read_bytes_u16addr(g_tlsc6x_client, RSP_ADDR, (uint8_t *) pcr, 1)) {
      break;
    }

    if (ptchcw->id != pcr->id) {
      continue;
    }
    /* delay(50); */
    tlsc6x_read_bytes_u16addr(g_tlsc6x_client, RSP_ADDR, (uint8_t *) pcr, LEN_RSP_CHK_RX);
    if (!tlsc6x_checksum_u16((uint16_t *) pcr, LEN_RSP_CHK_RX)) {
      if ((ptchcw->id == pcr->id) && (pcr->cc == 0)) {
        ret = 0;
      }
    }
    break;
  }
exit:
  /* clean rsp buffer */
  /* retry = 0; */
  /* tlsc6x_write_bytes_u16addr(g_tlsc6x_client, RSP_ADDR, (uint8_t*)&retry, 1); */

  return ret;

}

/* return 0=successful */
int tlsc6x_read_burn_space(uint8_t *pdes, uint16_t adr, uint16_t len)
{
  int rsp;
  uint32_t left = len;
  uint32_t combChk, retry;
  ctp_test_wr_t m_cmd;
  ctp_test_rd_t m_rsp;

  m_cmd.id = 0x31;
  m_cmd.resv = 0x03;
  while (left)
  {
    len = (left > MAX_BULK_SIZE) ? MAX_BULK_SIZE : left;

    m_cmd.d0 = adr;
    m_cmd.d1 = len;

    rsp = -1;
    retry = 0;
    while (retry++ < 3)
    {
      m_rsp.id = 0;
      if (tlsc6x_cmd_send(&m_cmd, &m_rsp) == 0X0)
      {
        tlsc6x_read_bytes_u16addr(g_tlsc6x_client, MTK_TXRX_BUF, pdes, len);
        combChk = tlsc6x_checksumEx(pdes, len);
        if (m_rsp.d0 == (uint16_t)combChk)
        {
          if (m_rsp.sn == (uint16_t)(combChk >> 16))
          {
            rsp = 0;
            break;
          }
        }
      }
    }

    if (rsp < 0) { break; }
    left -= len;
    adr += len;
    pdes += len;
  }

  return rsp;
}

int tlsc6x_write_burn_space(uint8_t *psrc, uint16_t adr, uint16_t len)
{
  int rsp = 0;
  uint16_t left = len;
  uint32_t retry, combChk;
  ctp_test_wr_t m_cmd;
  ctp_test_rd_t m_rsp;

  m_cmd.id = 0x30;
  m_cmd.resv = 0x11;

  while (left) {
    len = (left > MAX_BULK_SIZE) ? MAX_BULK_SIZE : left;
    combChk = tlsc6x_checksumEx(psrc, len);

    m_cmd.d0 = adr;
    m_cmd.d1 = len;
    m_cmd.d2 = (uint16_t) combChk;
    m_cmd.s2Pad0 = (uint16_t) (combChk >> 16);

    rsp = -1;  /* avoid dead loop */
    retry = 0;
    while (retry < 3) {
      tlsc6x_write_bytes_u16addr(g_tlsc6x_client, MTK_TXRX_BUF, psrc, len);
      m_rsp.id = 0;
      rsp = tlsc6x_cmd_send(&m_cmd, &m_rsp);
      if (rsp < 0) {
        if ((m_rsp.d0 == 0X05) && (m_rsp.cc == 0X09)) {  /* fotal error */
          break;
        }
        retry++;
      } else {
        left -= len;
        adr += len;
        psrc += len;
        break;
      }
    }

    if (rsp < 0) {
      break;
    }
  }

  return (!left) ? 0 : -1;
}

static int is_valid_cfg_data(const uint16_t *ptcfg)
{
  if (ptcfg == NULL) {
    return 0;
  }

  if ((uint8_t) ((ptcfg[53] >> 1) & 0x7f) != (uint8_t) (g_tlsc6x_client)) {
    return 0;
  }

  if (tlsc6x_checksum_u16(ptcfg, 204)) {
    return 0;
  }

  return 1;
}

//#ifdef TLSC_AUTO_UPGRADE
static int tlsc6x_tpcfg_ver_comp(const uint16_t* ptcfg)
{
  unsigned int u32tmp;
  uint16_t vnow, vbuild;

  if (g_tlsc6x_cfg_ver == 0) {  /* no available version information */
    return 0;
  }

  if (is_valid_cfg_data(ptcfg) == 0) {
    return 0;
  }

  u32tmp = ptcfg[1];
  u32tmp = (u32tmp << 16) | ptcfg[0];
  if ((g_tlsc6x_cfg_ver & 0x3ffffff) != (u32tmp & 0x3ffffff)) {
    return 0;
  }

  vnow = (g_tlsc6x_cfg_ver >> 26) & 0x3f;
  vbuild = (u32tmp >> 26) & 0x3f;
  ESP_LOGI(LOG_TAG, "vnow: 0x%x,vbuild: 0x%x", vnow, vbuild);
  if (vbuild <= vnow) {
    return 0;
  }

  return 1;
}
//#endif
static int tlsc6x_tpcfg_ver_comp_weak(uint16_t *ptcfg)
{
  unsigned int u32tmp;

  if (g_tlsc6x_cfg_ver == 0) {  /* no available version information */
    return 0;
  }

  if (is_valid_cfg_data(ptcfg) == 0) {
    ESP_LOGI(LOG_TAG, "Tlsc6x:cfg_data is invalid!");
    return 0;
  }

  u32tmp = ptcfg[1];
  u32tmp = (u32tmp << 16) | ptcfg[0];
  if ((g_tlsc6x_cfg_ver & 0x3ffffff) != (u32tmp & 0x3ffffff)) {  /*  */
    ESP_LOGI(LOG_TAG, "tlsc6x:ptcfg version error,g_tlsc6x_cfg_ver is 0x%x:ptcfg version is 0x%x!", g_tlsc6x_cfg_ver, u32tmp);
    return 0;
  }

  if (g_tlsc6x_cfg_ver == u32tmp) {
    return 0;
  }

  return 1;
}

/* 0 error */
/* 0x7f80 no data */
static uint16_t tlsx6x_find_last_cfg(void)
{
  uint16_t addr, check;

  addr = 0x7f80 - 256;
  while (addr > 0x6000) {  /* 0x6080 */
    check = 0;
    if (tlsc6x_read_burn_space((uint8_t *) &check, addr, 2)) {
      addr = 0;
      goto exit;
    }
    if (check == 0xffff) {
      break;
    }
    addr -= 256;
  }

  addr += 256;

exit:

  return addr;
}

//#ifdef TLSC_AUTO_UPGRADE
static int find_last_valid_burn_cfg(uint16_t *ptcfg)
{
  uint16_t addr;

  if (tlsc6x_download_ramcode(fw_burn_bin, sizeof(fw_burn_bin))) {
    return -EPERM;
  }

  addr = tlsx6x_find_last_cfg();
  if ((addr == 0) || (addr == 0x7f80)) {
    return -EPERM;
  }

  while (addr <= 0x7e80) {
    if (tlsc6x_read_burn_space((uint8_t *) ptcfg, addr, 204)) {
      addr = 0x7f80;  /* force error */
      break;
    }
    if (is_valid_cfg_data(ptcfg) == 0) {
      addr += 256;
    } else {
      break;
    }
  }

  return (addr <= 0x7e80) ? 0 : -1;

}

int tlsx6x_update_fcomp_cfg(uint16_t *ptcfg)
{

  if (tlsc6x_tpcfg_ver_comp_weak(ptcfg) == 0) {
    ESP_LOGI(LOG_TAG, "Tlsc6x:update error:version error!");
    return -EPERM;
  }

  if (g_tlsc6x_cfg_ver && ((uint16_t) (g_tlsc6x_cfg_ver & 0xffff) != ptcfg[0])) {
    return -EPERM;
  }

  if (tlsc6x_download_ramcode(fw_fcode_burn, sizeof(fw_fcode_burn))) {
    ESP_LOGI(LOG_TAG, "Tlsc6x:update error:ram-code error!");
    return -EPERM;
  }

  if (tlsc6x_write_burn_space((uint8_t *)ptcfg, 0x8000, 204)) {
    ESP_LOGI(LOG_TAG, "Tlsc6x:update fcomp_cfg fail!");
    return -EPERM;
  }

  ESP_LOGI(LOG_TAG, "Tlsc6x:update fcomp_cfg pass!");

  memcpy(tl_target_cfg, ptcfg, 204);
  g_tlsc6x_cfg_ver = (ptcfg[1] << 16) | ptcfg[0];
  tlsc_cfg_version=g_tlsc6x_cfg_ver>>26;

  return 0;
}

int tlsx6x_update_fcomp_boot(uint8_t *pdata, uint16_t len)
{

  if (tlsc6x_download_ramcode(fw_fcode_burn, sizeof(fw_fcode_burn))) {
    ESP_LOGI(LOG_TAG, "Tlsc6x:update error:ram-code error!");
    return -EPERM;
  }
  pdata[8] = 0xff;
  if (tlsc6x_write_burn_space((uint8_t *)pdata, 0x00, len)) {
    ESP_LOGI(LOG_TAG, "Tlsc6x:update fcomp_boot fail!");
    return -EPERM;
  }
  pdata[8] = 0x4b;
  if (tlsc6x_write_burn_space(&pdata[8], 0x08, 1)) {
    ESP_LOGI(LOG_TAG, "Tlsc6x:update fcomp_boot last sig-byte fail!");
    return -EPERM;
  }
  g_tlsc6x_boot_ver = pdata[5];
  g_tlsc6x_boot_ver = (g_tlsc6x_boot_ver<<8) + pdata[4];
  tlsc_boot_version = g_tlsc6x_boot_ver;
  ESP_LOGI(LOG_TAG, "Tlsc6x:update fcomp_boot pass!");

  return 0;
}

int tlsx6x_update_ocomp_boot(uint8_t *pdata, uint16_t len)
{
  unsigned int oo_tail[4] = { 0x60298bf, 0x15cbf, 0x60301bf, 0x3d43f };

  if (tlsc6x_download_ramcode(fw_burn_bin, sizeof(fw_burn_bin))) {
    ESP_LOGI(LOG_TAG, "Tlsc6x:update error:ram-code error!");
    return -EPERM;
  }

  if (tlsc6x_write_burn_space((uint8_t *)pdata, 0x00, len)) {
    ESP_LOGI(LOG_TAG, "Tlsc6x:update ocomp_boot fail!");
    return -EPERM;
  }

  if (tlsc6x_write_burn_space((uint8_t *)oo_tail, 0x7fec, 16)) {
    ESP_LOGI(LOG_TAG, "Tlsc6x:update ocomp_boot fail!");
    return -EPERM;
  }
  ESP_LOGI(LOG_TAG, "Tlsc6x:update ocomp_boot pass!");

  return 0;
}

int tlsx6x_update_burn_cfg(uint16_t *ptcfg)
{
  uint16_t addr, check;

  if (g_mccode == 1) {
    return tlsx6x_update_fcomp_cfg(ptcfg);
  }

  if (tlsc6x_tpcfg_ver_comp_weak(ptcfg) == 0) {
    ESP_LOGI(LOG_TAG, "Tlsc6x:update error:version error!");
    return -EPERM;
  }

  if (g_tlsc6x_cfg_ver && ((uint16_t) (g_tlsc6x_cfg_ver & 0xffff) != ptcfg[0])) {
    return -EPERM;
  }

  if (tlsc6x_download_ramcode(fw_burn_bin, sizeof(fw_burn_bin))) {
    ESP_LOGI(LOG_TAG, "Tlsc6x:update error:ram-code error!");
    return -EPERM;
  }

  addr = tlsx6x_find_last_cfg();
  if ((addr <= 0x6180) || (addr == 0x7f80)) {
    ESP_LOGI(LOG_TAG, "Tlsc6x:update error:time limit!");
    return -EPERM;
  }

  addr = addr - 256;

  /* pre-check */
  check = 0;
  if (tlsc6x_read_burn_space((uint8_t *)&check, addr - 256, 2)) {
    ESP_LOGI(LOG_TAG, "Tlsc6x:update error:pre-read error!");
    return -EPERM;
  }
  if (check != 0xffff) {
    ESP_LOGI(LOG_TAG, "Tlsc6x:update error:pre-read limit!");
    return -EPERM;
  }

  if (tlsc6x_write_burn_space((uint8_t *)ptcfg, addr, 204)) {
    ESP_LOGI(LOG_TAG, "Tlsc6x:update fail!");
    return -EPERM;
  }

  ESP_LOGI(LOG_TAG, "Tlsc6x:update pass!");

  memcpy(tl_target_cfg, ptcfg, 204);
  g_tlsc6x_cfg_ver = (ptcfg[1] << 16) | ptcfg[0];
  g_tlsc6x_chip_code = (uint16_t)((ptcfg[53] >>8)&0x0f);

  tlsc_cfg_version=g_tlsc6x_cfg_ver>>26;

  return 0;
}

int tlsc6x_update_f_combboot(uint8_t *pdata, uint16_t len)
{
        int ret = 0;
        int i = 0;
        uint32_t check_sum = 0;
        uint16_t boot_len;

  boot_len = pdata[7];
  boot_len = (boot_len << 8) + pdata[6];
  ESP_LOGI(LOG_TAG, "Tlsc6x:update file size is %d, and boot len is %d !",len,boot_len);

  if (g_mccode == 0) {
    if (g_needKeepRamCode == 0) {
      ESP_LOGI(LOG_TAG, "Tlsc6x:update_f_combboot error:mccode error!");
      return -EPERM;
    }
    if ((len >= boot_len) && ((pdata[2] == 0x35) && (pdata[3] == 0x35))) {
      ret = tlsx6x_update_ocomp_boot(pdata, boot_len);
      pdata += boot_len;
      len = len - boot_len;
    }
    if ((ret == 0) && (len >= 204)) {
      memcpy(tl_buf_tmpcfg, pdata, 204);
      ret = tlsx6x_update_burn_cfg(tl_buf_tmpcfg);
    }
    return ret;
  }

  if ((len >= boot_len) && ((pdata[2] == 0x36) && (pdata[3] == 0x35))) {
               check_sum = tlsc6x_checksumEx(pdata, boot_len);
               for(i=0;i<4;i++){
        pdata[boot_len + i] = (check_sum>>(i*8)) & 0xff;
          }
    ret = tlsx6x_update_fcomp_boot(pdata, (boot_len + 4));
    pdata += boot_len;
    len = len - boot_len;
  }

  return ret;

}


/* NOTE:caller guarantee the legitimacy */
/* download tp-cfg. */
int tlsx6x_update_running_cfg(const uint16_t *ptcfg)
{
  unsigned int retry;
  unsigned int tmp[2];

  if (is_valid_cfg_data(ptcfg) == 0) {
    return -EPERM;
  }
  if (tlsc6x_set_dd_mode()) {
    return -EPERM;
  }

  if (tlsc6x_bulk_down_check((uint8_t *)ptcfg, 0xd7e0, 204)) {  /* stop mcu */
    goto exit;
  }

  tmp[0] = 0x6798;
  tmp[1] = 0xcd3500ff;

  retry = 0;
  while (++retry < 3) {
    if (tlsc6x_write_bytes_u16addr(g_tlsc6x_client, 0xdf10, (uint8_t *) &tmp[0], 8)) {
      delay(5);
      continue;
    }
    break;
  }

  /* write error? don't care */
  retry = 0;
  while (++retry < 5) {
    delay(5);
    tmp[0] = 0;
    tlsc6x_read_bytes_u16addr(g_tlsc6x_client, 0xdf16, (uint8_t *) &tmp[0], 1);
    if (tmp[0] == 0x30) {
      break;
    }
  }

exit:
  tlsc6x_set_nor_mode();
  memcpy(tl_target_cfg, ptcfg, 204);
  return 0;
}

/* return :0->no hw resetting needed */
/* else -> caller do hw resettting */


/* 0:successful */
static int tlsc6x_download_gestlib_fast(const uint8_t *pcode, uint16_t len)
{
  uint8_t dwr, retry;
  int ret = -2;

  if (tlsc6x_set_dd_mode()) {
    return -EPERM;
  }

  dwr = 0x05;
  if (tlsc6x_bulk_down_check(&dwr, 0x0602, 1) == 0) {  /* stop mcu */
    dwr = 0x00;
    tlsc6x_bulk_down_check(&dwr, 0x0643, 1);  /* disable irq */
  } else {
    return -EPERM;
  }

  if (tlsc6x_bulk_down_check(pcode, 0x8000, 1024) == 0) {
    if (tlsc6x_write_bytes_u16addr(g_tlsc6x_client, 0x8400, pcode + 1024, len - 1024) == 0) {  /*  */
      ret = 0;
    }
  }

  if (ret == 0) {
    dwr = 0x88;
    retry = 0;
    do {
      ret = tlsc6x_write_bytes_u16addr(g_tlsc6x_client, 0x0602, &dwr, 1);
    } while ((++retry < 3) && (ret != 0));
  }

  delay(40);    /* 30ms */
  if (tlsc6x_get_i2cmode() == DIRECTLY_MODE) {
    ret = tlsc6x_download_ramcode(pcode, len);
  }

  return ret;
}

int tlsc6x_load_ext_binlib(const uint8_t *pdata, uint16_t len)
{
  int ret = 0;
  uint16_t boot_len;

  boot_len = pdata[7];
  boot_len = (boot_len << 8) + pdata[6];

  if (len >= boot_len) {
    ret = tlsc6x_download_ramcode(pdata, boot_len);
    pdata += boot_len;
    len = len - boot_len;
    if ((ret == 0) && (len >= 204)) {
      delay(30);
      ret = tlsx6x_update_running_cfg((uint16_t *) pdata);
    }
  }

  return 0;
}

/*
 *get running time tp-cfg.  
 *@ptcfg:  data buffer
 *@addr:  real data address for different chips
 *
 *return: 0 SUCESS else FAIL
 * Note: touch chip   MUST work in DD-mode.
*/
static int tlsx6x_comb_get_running_cfg(uint16_t *ptcfg, uint16_t addr)
{
  int retry, err_type;

  retry = 0;
  err_type = 0;
  
  tlsc6x_set_dd_mode();
  
  while (++retry < 5) {
    err_type = 0;
    if (tlsc6x_read_bytes_u16addr(g_tlsc6x_client, addr, (uint8_t *) ptcfg, 204)) {
      delay(20);
      err_type = 2;  /* i2c error */
      continue;
    }

    if (is_valid_cfg_data(ptcfg) == 0) {
      tlsc6x_set_dd_mode();
      err_type = 1;  /* data error or no data */
      delay(20);
      continue;
    }
    break;
  }

  return err_type;

}


static int tlsx6x_3535get_running_cfg(uint16_t *ptcfg)
{
  return tlsx6x_comb_get_running_cfg(ptcfg, 0xd6e0);
}

static int tlsx6x_3536get_running_cfg(uint16_t *ptcfg)
{
  return tlsx6x_comb_get_running_cfg(ptcfg, 0x9e00);
}

static int tlsx6x_3535find_lastvaild_ver(void)
{
  if (find_last_valid_burn_cfg(tl_buf_tmpcfg) == 0) {
    g_tlsc6x_cfg_ver = (unsigned int)tl_buf_tmpcfg[1];
    g_tlsc6x_cfg_ver = (g_tlsc6x_cfg_ver<<16) + (unsigned int)tl_buf_tmpcfg[0];

    tlsc_cfg_version = g_tlsc6x_cfg_ver>>26;
    tlsc_vendor_id = (g_tlsc6x_cfg_ver>>9)&0x7F;
               tlsc_project_id = g_tlsc6x_cfg_ver&0x01FF;
  }

  return 0;
}

static int tlsx6x_3536find_lastvaild_ver(void)
{
  if (tlsc6x_download_ramcode(fw_fcode_burn, sizeof(fw_fcode_burn))) {
    ESP_LOGI(LOG_TAG, "Tlsc6x:update error:ram-code error!");
    return -EPERM;
  }

  if (tlsc6x_read_burn_space((uint8_t *) tl_buf_tmpcfg, 0xf000, 204)) {
    return -EPERM;
  }

  if (is_valid_cfg_data(tl_buf_tmpcfg)) {
    g_tlsc6x_cfg_ver = (unsigned int)tl_buf_tmpcfg[1];
    g_tlsc6x_cfg_ver = (g_tlsc6x_cfg_ver<<16) + (unsigned int)tl_buf_tmpcfg[0];
    g_tlsc6x_cfg_ver=g_tlsc6x_cfg_ver&0x3ffffff;
    tlsc_cfg_version = g_tlsc6x_cfg_ver>>26;
    tlsc_vendor_id = (g_tlsc6x_cfg_ver>>9)&0x7F;
               tlsc_project_id = g_tlsc6x_cfg_ver&0x01FF;
  }
  return 0;
}

static int tlsc6x_upgrade_romcfg_array(uint16_t *parray, unsigned int cfg_num)
{
  unsigned int  k;

  ESP_LOGI(LOG_TAG, "g_tlsc6x_cfg_ver is 0x%x", g_tlsc6x_cfg_ver);
  if (g_tlsc6x_cfg_ver == 0) {  /* no available version information */
    ESP_LOGI(LOG_TAG, "Tlsc6x:no current version information!");
    return 0;
  }

  new_idx_active = -1;

  for (k = 0; k < cfg_num; k++) {
    if (tlsc6x_tpcfg_ver_comp(parray) == 1) {
      new_idx_active = k;
      ESP_LOGI(LOG_TAG, "%s, new_idx_active is %d.", __func__, new_idx_active);
      break;
    }
    parray = parray + 102;
  }

  if (new_idx_active < 0)
  {
    ESP_LOGI(LOG_TAG, "Tlsc6x:auto update skip:no updated version!");
    return -EPERM;
  }

  if (tlsc6x_set_dd_mode())
  {
    ESP_LOGI(LOG_TAG, "Tlsc6x:auto update error:can't control hw mode!");
    return -EPERM;
  }

  if (tlsx6x_update_burn_cfg(parray) == 0) {
    ESP_LOGI(LOG_TAG, "Tlsc6x:update pass!");
  } else {
    ESP_LOGI(LOG_TAG, "Tlsc6x:update fail!");
  }

  return 1;    /* need hw reset */


}


static int tlsc6x_boot_ver_comp(unsigned int ver)
{
  if (g_tlsc6x_boot_ver == 0) {
    return 1;
  }

  if (ver  > g_tlsc6x_boot_ver ) {
    return 1;
  }  

  return 0;
}

static int tlsc6x_3536boot_update(uint8_t *pdata, uint16_t boot_len)
{
  unsigned int ver = 0;

  ver = pdata[5];
  ver = (ver<<8) + pdata[4];

  if (tlsc6x_boot_ver_comp(ver) == 0) {
    ESP_LOGI(LOG_TAG, "Tlsc6x:3536 boot not need update!");
    return 0;
  }
  
  return  tlsx6x_update_fcomp_boot(pdata, boot_len);
}

static int tlsc6x_3535boot_update(const uint8_t *pdata, uint16_t boot_len)
{
  unsigned int ver = 0;

  ver = pdata[5];
  ver = (ver<<8) + pdata[4];

  if (tlsc6x_boot_ver_comp(ver) == 0) {
    ESP_LOGI(LOG_TAG, "Tlsc6x:3535 boot not need update!");
    return 0;
  }
  
  g_needKeepRamCode = 1;
  
  return tlsc6x_load_ext_binlib(pdata, boot_len);
}

static int tlsc6x_boot_update(uint8_t *pdata, uint16_t boot_len)
{
  
  if (g_mccode == 0) {
    return tlsc6x_3535boot_update(pdata, boot_len);
  }

  return tlsc6x_3536boot_update(pdata, boot_len);
}

int tlsc6x_update_compat_ctl(uint8_t *pupd, int len)
{
  uint32_t k;
  uint32_t n;
  uint32_t offset;
  uint32_t *vlist;

  int ret = -1;

  struct tlsc6x_updfile_header *upd_header;

  if (len < sizeof(struct tlsc6x_updfile_header)) { return -EPERM; }

  upd_header = (struct tlsc6x_updfile_header *) pupd;

  if (upd_header->sig != 0x43534843) { return -EPERM; }

  n = upd_header->n_cfg;
  offset = (upd_header->n_match * 4) + sizeof(struct tlsc6x_updfile_header);

  if ((offset + upd_header->len_cfg + upd_header->len_boot) != len) { return -EPERM; }
  
  if ((n * 204) != upd_header->len_cfg) { return -EPERM; }

  if (n != 0)
  {
    tlsc6x_upgrade_romcfg_array((uint16_t *) (pupd + offset), n);
  }

  n = upd_header->n_match;
  if (n != 0) {
    vlist = (uint32_t *) (pupd + sizeof(struct tlsc6x_updfile_header));
    offset = offset + upd_header->len_cfg;
    for (k=0; k < n; k++)
    {
      if (vlist[k] == (g_tlsc6x_cfg_ver & 0xffffff))
      {
        ret = tlsc6x_boot_update((pupd + offset), upd_header->len_boot);
        if(0 == ret)
        {
          break;
        }
        else
        {
          return 1;
        }
      }
    }
  }
  return 0;
}

int tlsc6x_do_update_ifneed(void)
{
  uint8_t* fupd = (uint8_t*)malloc(sizeof(fw_file_tlsc6x_52_08));
  fw_size = sizeof(fw_file_tlsc6x_52_08);
  memcpy (fupd, fw_file_tlsc6x_52_08, fw_size);
  auto res = tlsc6x_update_compat_ctl(fupd, fw_size);
  free(fupd);
  return res;
}

int tlsc6x_get_running_cfg(uint16_t *ptcfg)
{
  if (g_mccode == 0) {
    return tlsx6x_3535get_running_cfg(ptcfg);
  }
  return tlsx6x_3536get_running_cfg(ptcfg);
}

int tlsc6x_find_ver(void)
{
  if (g_mccode == 0) {
    return tlsx6x_3535find_lastvaild_ver();
  }
  return tlsx6x_3536find_lastvaild_ver();
}

/* NOT a public function, only one caller!!! */
static void tlsc6x_tp_mccode(void)
{
  uint32_t tmp[3];

  g_mccode = 0xff;

  if (tlsc6x_read_bytes_u16addr(g_tlsc6x_client, 0x8000u, (uint8_t *) tmp, 12))
  {
    return;
  }
  if (tmp[2] == 0x544c4e4b) {  /*  boot code  */
    if (tmp[0] == 0x35368008) {
      g_mccode = 1;
      g_tlsc6x_boot_ver = tmp[1] & 0xffff;
      tlsc_boot_version = g_tlsc6x_boot_ver;
    } else if (tmp[0] == 0x35358008) {
      g_mccode = 0;
      g_tlsc6x_boot_ver = tmp[1] & 0xffff;
      tlsc_boot_version = g_tlsc6x_boot_ver;
    }
  } else if (tmp[2] == 0x544c4ebd) {
      if (tmp[0] == 0x35368008) {
      g_mccode = 1;
      g_tlsc6x_boot_ver = 0;
      tlsc_boot_version = g_tlsc6x_boot_ver;
    } else if (tmp[0] == 0x35358008) {
      g_mccode = 0;
      g_tlsc6x_boot_ver = tmp[1] & 0xffff;
      tlsc_boot_version = g_tlsc6x_boot_ver;
    }
  } else {  /* none code */
    tmp[0] = 0;
    if (tlsc6x_read_bytes_u16addr(g_tlsc6x_client, 0x09, (uint8_t *) tmp, 3)) {
      return;
    }
    if ((tmp[0] == 0x444240) || (tmp[0] == 0x5c5c5c)){
      g_mccode = 1;
    } else {
      g_mccode = 0;
    }
  }

  if (g_mccode == 0) {
    MTK_TXRX_BUF = 0x80cc00;
    CMD_ADDR = 0x80b400;
    RSP_ADDR = 0x80b440;
    //chip_op_if.get_running_cfg = tlsx6x_3535get_running_cfg;
    //chip_op_if.find_ver = tlsx6x_3535find_lastvaild_ver;
    //chip_op_if.update_boot = tlsc6x_3535boot_update;
  } else {
    MTK_TXRX_BUF = 0x809000;
    CMD_ADDR = 0x809f00;
    RSP_ADDR = 0x809f40;
    //chip_op_if.get_running_cfg = tlsx6x_3536get_running_cfg;
    //chip_op_if.find_ver = tlsx6x_3536find_lastvaild_ver;
    //chip_op_if.update_boot = tlsc6x_3536boot_update;
  }

}

void tlsc6x_tp_reset_active(void)
{
/*
  struct tlsc6x_platform_data *pdata = g_tp_drvdata->platform_data;

  gpio_direction_output(pdata->reset_gpio_number, 1);
  gpio_set_value(pdata->reset_gpio_number, 0);
  delay(20);
  gpio_set_value(pdata->reset_gpio_number, 1);
  delay(2);
//*/
}

int tlsc6x_tp_dect(void)
{
  int loop;
  uint8_t dwr;
  int ret = -1;
    
  g_mccode = 0;    /* default */

  for (loop = 0; loop < 5; loop++)
  {
    if (tlsc6x_set_dd_mode()) {
      tlsc6x_tp_reset_active();
      dwr = 0x05;
      if (tlsc6x_bulk_down_check(&dwr, 0x0602, 1) == 0) {  
        dwr = 0x00;
        tlsc6x_bulk_down_check(&dwr, 0x0643, 1);  
      } else {
       ESP_LOGI(LOG_TAG, "write 0x0602 failed ");
      }
    } else {
      break;
    }
  }

  if (loop >= 5) {
    ESP_LOGI(LOG_TAG, "tlsc6x_set_dd_mode failed ");
  }

  tlsc6x_tp_mccode();  /* MUST: call this function there!!! */
  ESP_LOGI(LOG_TAG, "g_mccode is 0x%x",g_mccode);

  if (g_mccode == 0xff) {
    ESP_LOGI(LOG_TAG, "get mccode fail");
    g_mccode = 1;
    MTK_TXRX_BUF = 0x809000;
    CMD_ADDR = 0x809f00;
    RSP_ADDR = 0x809f40;
    g_tlsc6x_boot_ver = 0;
  }

  /*try to get running time tp-cfg. if fail : wrong boot? wrong rom-cfg?*/
  if (tlsc6x_get_running_cfg(tl_buf_tmpcfg) == 0)
  {
    g_tlsc6x_cfg_ver = (unsigned int)tl_buf_tmpcfg[1];
    g_tlsc6x_cfg_ver = (g_tlsc6x_cfg_ver<<16) + (unsigned int)tl_buf_tmpcfg[0];
    g_tlsc6x_chip_code = (uint16_t)((tl_buf_tmpcfg[53] >>8)&0x0f);

    tlsc_cfg_version = g_tlsc6x_cfg_ver>>26;
    tlsc_vendor_id = (g_tlsc6x_cfg_ver>>9)&0x7F;
    tlsc_project_id = g_tlsc6x_cfg_ver&0x01FF;
  }
  else
  {
    if(0 == tl_buf_tmpcfg[2] && 0 == tl_buf_tmpcfg[3]) {
      g_mccode = 1;
      MTK_TXRX_BUF = 0x809000;
      CMD_ADDR = 0x809f00;
      RSP_ADDR = 0x809f40;
      g_tlsc6x_boot_ver = 0;
    }
    tlsc6x_find_ver();
  }
  
  if (g_tlsc6x_cfg_ver == 0) {
    ESP_LOGI(LOG_TAG, "get cfg-ver fail");
    goto exit;
  }

  ret = tlsc6x_do_update_ifneed();

  if(0 != ret) {
    return 0;
  }
exit:

  tlsc6x_set_nor_mode();

  return 1;
}

constexpr const uint8_t fw_burn_bin[2672] = {
  0x08, 0x80, 0x6f, 0x6d, 0x03, 0x02, 0x00, 0x00, 0x4b, 0x4e, 0x4c, 0x54, 0x80, 0x01, 0x88, 0x00,
  0x30, 0x80, 0xc0, 0x46, 0x00, 0xa0, 0x11, 0x09, 0x08, 0x50, 0x14, 0x09, 0x14, 0x0a, 0x08, 0x50,
  0x04, 0xb1, 0x91, 0x02, 0xfb, 0xcb, 0x09, 0x08, 0xc0, 0x6b, 0x0a, 0x08, 0x85, 0x06, 0x08, 0x08,
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  0x31, 0x00, 0x00, 0x00, 0x0d, 0x03, 0x00, 0x00, 0x33, 0x00, 0x00, 0x00, 0x21, 0x07, 0x00, 0x00
};

constexpr const uint8_t fw_fcode_burn[1776] = {
  0x08,0x80,0x6F,0x6D,0x00,0x00,0xF0,0x06,0x4B,0x4E,0x4C,0x54,0x80,0x01,0x88,0x00,
  0x34,0x80,0xC0,0x46,0x00,0xA0,0x17,0x09,0x17,0x0A,0x08,0x50,0x04,0xB1,0x91,0x02,
  0xFB,0xCB,0x0C,0x08,0xC0,0x6B,0x0D,0x08,0x85,0x06,0x0B,0x08,0xC0,0x6B,0x0C,0x08,
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  0x00,0xFC,0x24,0xFC,0x95,0x02,0xF1,0xC8,0x24,0xF4,0x20,0x03,0x30,0x6D,0xC0,0x46
};

